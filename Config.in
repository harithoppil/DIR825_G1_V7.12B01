## src/apps/logic/Config.in
```kconfig
menuconfig APPS_LOGIC
	bool 'LOGIC'
	default y
	depends on APPS
  	help
      	LOGIC

config APPS_UPDATE_UBOOT
	bool 'Support update uboot'
	default y
	depends on APPS_LOGIC
	help
	    Support update uboot

config APPS_LOGIC_IPV6
	bool 'Support IPv6'
	default y
	depends on TBS_SUPPORT_IPV6 && APPS_LOGIC
	help
	    IPV6 feature

config APPS_LOGIC_IPV6_ENABLE
	bool 'IPv6 Enable & Disable'
	default y
	depends on APPS_LOGIC
	help
	    Enable IPv6 & Diable IPv6 server 

config APPS_LOGIC_ClubWifi
	bool 'Support ClubWifi'
	default y
	depends on APPS_LOGIC
	help
	    ClubWifi feature

config APPS_LOGIC_WLAN
	bool 'WLAN'
	default n
	depends on APPS_LOGIC
	help 
		Wlan module
	
config LOGIC_WLAN_MULTI_NETWORK_CARD
	bool 'WLAN Support Multi Network Card'
	default N
	depends on APPS_LOGIC_WLAN
	help
		Support support multi network card
	
config APPS_LOGIC_5GWIFI
        bool "WLAN 5G HTML Page"
    	default y
    	depends on APPS_LOGIC_WLAN
    	help
        	5G wireless page display switch, only for html mark, no useful for logic modules.

config APPS_LOGIC_WPS
	bool 'WPS'
	default n
	depends on APPS_LOGIC_WLAN
	help
	Support	WPS(WiFi Protected Setup) in WLAN module

config APPS_LOGIC_WPS_V2 
	bool 'WPS 2.0'
	default n
	depends on APPS_LOGIC_WPS
	help
		Support WPS 2.0(WiFi Protected Setup 2.0) in WLAN module

config APPS_LOGIC_WPS_LED
	bool 'WPS Led'
	default y
	depends on APPS_LOGIC_WPS
	help
	Support WPS Led in WLAN module

config APPS_LOGIC_WPS_LED_COLOR
	bool 'WPS Led Color'
	default y
	depends on APPS_LOGIC_WPS
	help
	Support WPS Led in WLAN module
	   
config APPS_LOGIC_WDS
	bool 'WDS'
	default n
	depends on APPS_LOGIC_WLAN
	help
	Support WDS in WLAN module

#comment '----------Select Spatial Streams Type---------------'
choice
	depends on APPS_LOGIC_WLAN
	prompt "Spatial Streams"
config APPS_LOGIC_WLAN_MIMO_1X1
		bool "1x1"
config	APPS_LOGIC_WLAN_MIMO_1X2 
		bool "1x2"    	
config	APPS_LOGIC_WLAN_MIMO_2X2 
		bool "2x2"
config	APPS_LOGIC_WLAN_MIMO_3X3 
		bool "3x3"		
endchoice
	
config APPS_LOGIC_PPPOE
	bool 'PPPoE'
	default n
	depends on APPS_LOGIC
    help
	  PPPoE module

config APPS_LOGIC_DUAL_ACCESS
	bool 'Russia Dual Access'
	default n
	depends APPS_LOGIC_PPPOE
    help
	  Russia dual access support
	   
config APPS_LOGIC_PPP_RETRY
	bool 'PPP Retry Mechanism'
	default n
	depends on APPS_LOGIC_PPPOE
	help
		A retry mechanism for PPP Data Session

config APPS_LOGIC_VPN
   bool 'VPN'
   default n
   depends on APPS_LOGIC_PPPOE
   help
      VPN module

config APPS_LOGIC_VPN_SDK
   bool 'VPN_SDK'
   default n
   depends on APPS_LOGIC_VPN
   help
      MTK SDK VPN ppp plugins pptp and openl2tp-1.6 
      
config APP_LOGIC_PPPOU
    bool 'PPP over usb modem(For GPRS/CDMA/3G wireless module)'
    default n
    depends on APPS_LOGIC_PPPOE
    help
       Support ppp on usb modem module

config APPS_LOGIC_USBPIN
    bool '3G pin management(For GPRS/CDMA/3G sim card)'
    default n
    depends on APP_LOGIC_PPPOU
    help
       Pin code manage on usb 3g sim card module

config APPS_LOGIC_LAN
	bool 'LAN'
	default n
	depends on APPS_LOGIC
	select OPENSOURCE_BRCTL
	help
	  Lan module

config APPS_LOGIC_LAN_VLAN
	bool 'LAN_VLAN'
	default n
	depends on APPS_LOGIC_LAN
	help
	  Lan vlan module
	  
config APPS_LOGIC_LAN_VLAN_RESERVE
	bool 'LAN_VLAN_RESERVE'
	default n
	depends on APPS_LOGIC_LAN_VLAN
	help
	  Lan vlan module reserve inst (dlink for Malay)

config APPS_LOGIC_LAN_VLAN_EXNAME
	bool 'LAN_VLAN_EXNAME'
	default n
	depends on APPS_LOGIC_LAN_VLAN_RESERVE
	help
	  Lan vlan module reserve inst (dlink for Malay)
	  
config APPS_LOGIC_LAN_PORT_VLAN
	bool 'LAN_PORT_VLAN'
	default n
	depends on APPS_LOGIC_LAN
	help
	  Lan port vlan module
config APPS_LOGIC_DNS
	bool 'DNS'
	default n
	depends on APPS_LOGIC
	help
	  DNS module

config APPS_LOGIC_DDNS
    bool 'DDNS'
    default n
    depends on APPS_LOGIC
    help
      ddns module, config dynamic DNS.

config APPS_LOGIC_DDNS_PEANUTHULLCLIENT
	bool 'Peanuthull Clinet'
	default n
	depends on APPS_LOGIC_DDNS
	help
	  Support DDNS peanuthull client for D_link

config APPS_LOGIC_WANSELECT
    bool 'WANSELECT'
    default n
    depends on APPS_LOGIC
    select LAN_AS_WAN
    help
      wanselect module, select WAN access type.

config APPS_LOGIC_WAN
	bool 'WAN'
	default n
	depends on APPS_LOGIC
	help
	  Wan module


config APPS_LOGIC_WAN_SERVICETYPE
	bool 'WAN_SERVICETYPE'
	default n
	depends on APPS_LOGIC_WAN
	help
	  Wan connection type

config APPS_LOGIC_INTERNET_LED
	bool 'INTERNET_LED(TR068)'
	default y
	depends on APPS_LOGIC_WAN
	help
	Wan internet led module
	
config APPS_LOGIC_INTERNET_LED_DLINK
	bool 'INTERNET_LED(for consume dlink)'
	default y
	depends on APPS_LOGIC_WAN
	help
	Wan internet led module

config APP_LOGIC_SINGLE_WAN
	bool "single wan support"
	default y
	depends on APPS_LOGIC_WAN
        help
        single Wan support

#config APPS_LOGIC_WAN_VLAN
#	bool 'WAN_VLAN'
#	default n
#	depends on APPS_LOGIC_WAN
#	help
#	  Wan vlan module

config APPS_LOGIC_IPCONN
	bool 'IPCONN'
	default n
	depends on APPS_LOGIC
	help
	  IPConn module

config APPS_LOGIC_DHCPC_OPTION15
	bool 'DHCPC_OPTION15(Domain Name Option)'
	default n
	depends on APPS_LOGIC_IPCONN
	help
	  DHCP option15

config APPS_LOGIC_DHCPC_OPTION42
	bool 'DHCPC_OPTION42(Network Time Protocol Servers Option)'
	default n
	depends on APPS_LOGIC_IPCONN
	help
	  DHCP option42

#	config APPS_LOGIC_DHCPC_OPTION250
#		bool 'DHCPC_OPTION250()'
#		default n
#		depends on APPS_LOGIC_IPCONN
#	  	help
#	        DHCP option250

config APPS_LOGIC_ETHWAN
	bool 'ETHWAN'
	default n
	depends on APPS_LOGIC
	help
	  EthWan module

config APPS_LOGIC_ETHLAN
	bool 'ETHLAN'
	default n
	depends on APPS_LOGIC
	help
	  EthLan module

config APPS_LOGIC_TR069
	bool 'TR069'
	default n
	depends on APPS_LOGIC
	select APPS_TR069
	help
		TR069 module

config APPS_LOGIC_TR111
	bool 'TR111'
	default n
	depends on APPS_LOGIC_TR069
	help
		TR111 for TR069 module
		
config TBS_BACKUP_ENCRYPTION
	bool 'backup encryption'
	default y
	depends on APPS_LOGIC_TR069
	help
		backup encryption for TR069 module

config APPS_LOGIC_TR064BE
	bool 'TR064BE'
	default n
	depends on APPS_LOGIC
	select APPS_TR064
	help
		TR064 module

config APPS_LOGIC_IPT
	bool 'IPT'
	default n
	depends on APPS_LOGIC
	help
		NAPT/NAT module

config APPS_LOGIC_PORTMAPPING
	bool 'PORTMAPPING'
    default n
    depends on APPS_LOGIC
    help
    	PORTMAPPING module

config APPS_LOGIC_PORTFORWARD
	bool 'PORTFORWARD'
    default n
    depends on APPS_LOGIC
    help
    	PORTFORWARD module

config APPS_LOGIC_INBOUND_FILTER
	bool 'InBound Filter'
    default n
    depends on APPS_LOGIC
    help
    	InBound Filter module

config APPS_LOGIC_ACL
	bool 'ACL'
	default n
	depends on APPS_LOGIC
	help
		ACL(RACL/LACL) module

config APPS_LOGIC_IP_ACL
	bool 'IP_ACL'
	default n
	depends on APPS_LOGIC
	help
		IP_ACL module

config APPS_LOGIC_DEFAULT_GATEWAY
	bool 'DEFAULT_GATEWAY'
	default n
	depends on APPS_LOGIC
	help
		DEFAULT_GATEWAY module

config APPS_LOGIC_NATPRIO
	bool 'NATPRIO'
	default n
	depends on APPS_LOGIC
	help
		NAT PRIO module

config APPS_LOGIC_LOGGER
	bool 'LOGGER'
	default n
	depends on APPS_LOGIC
	help
		LOGGER module

config APPS_LOGIC_PING
	bool 'Ping'
	default n
	depends on APPS_LOGIC
	help
		Ping module

config PING_SUPPORT_IPV6
	bool 'Ping Support IPV6'
	default n
	depends on APPS_LOGIC_PING
	help
		Ping Support IPV6		

config APPS_LOGIC_DIAG
	bool 'Diagnostics'
	default n
	depends on APPS_LOGIC
	help
		Ping module

config APPS_LOGIC_DHCPS
	bool 'Dhcp Server'
	default n
	depends on APPS_LOGIC
	select OPENSOURCE_UDHCP
	help
		Dhcp Server module

config APPS_LOGIC_DHCPS_FILTER
	bool 'Dhcp Server filter'
	default n
	depends on APPS_LOGIC_DHCPS
	help
		Dhcp Server module

config APPS_LOGIC_DHCPS_OPTION125
	bool 'Dhcp Server Option125'
	default n
	depends on APPS_LOGIC_DHCPS
	help
		Dhcp Server module

config APPS_LOGIC_DHCPR
	bool 'Dhcp Relay'
	default n
	depends on APPS_LOGIC
	select OPENSOURCE_DHCPR
	help
	Dhcp Relay module

config APPS_LOGIC_PORTTRIGGER
	bool 'Port Trigger'
	default n
	depends on APPS_LOGIC
	select IP_NF_TARGET_TRIGGER
	help
		Port Trigger module

config APPS_LOGIC_ALG
	bool 'ALG'
	default n
	depends on APPS_LOGIC
	help
		ALG module

config APPS_LOGIC_DEVCONFIG
	bool 'DEVCONFIG'
	default n
	depends on APPS_LOGIC
	help
		DevConfig module
		
config LAST_SAVE_CFG
	bool 'SAVE OR RECOVER LAST CONFIG'
	default n
	depends on APPS_LOGIC_DEVCONFIG && JFFS2_FS
	help
		Save or recover last config

config APPS_LOGIC_AUTH
	bool 'Auth'
	default n
	depends on APPS_LOGIC
	help
		Auth module

config SUPORT_DYNAMIC_TELNET_PASSWORD
	bool 'dynamic telnet password'
	default y
	depends on APPS_LOGIC
	help
		dynamic telnet password the same with web password

config APPS_LOGIC_IGMP
	bool 'IGMP Proxy & Snooping'
    default n
    depends on APPS_LOGIC
	select OPENSOURCE_IGMPPROXYV3
    help
    	IGMP Proxy & Snooping Configuration Module

config APPS_LOGIC_STATIC_IGMP
        bool 'Static IGMP'
        default n
        depends on APPS_LOGIC_IGMP
	select IGMP_SNOOPING_STATIC
	help
	    Support static IGMP Configuration Module

config APPS_LOGIC_MLD
	bool 'MLD Proxy & Snooping'
	default y
	depends on APPS_LOGIC && TBS_SUPPORT_IPV6
	select OPENSOURCE_MLD
	help
	MLD	Proxy &	Snooping Configuration Module

config APPS_LOGIC_UPNP
	bool 'UPnP'
    default n
    depends on APPS_LOGIC
	select OPENSOURCE_UPnP
    help
    	UPnP Configuration Module

#config APPS_LOGIC_BRIDGE
#		bool 'BRIDGE'
#		default n
#		depends on APPS_LOGIC
#	  	help
#		Bridge module

config APPS_LOGIC_MULTILANG
	bool 'Multi_Language'
	default n
	depends APPS_LOGIC
	help
		multilang module.
		
config APPS_LOGIC_SNMPC
	bool 'SNMP Configuration'
	default n
	depends on APPS_LOGIC
	help
		Configuration module

config APPS_LOGIC_MAIL
	bool 'MAIL Configuration'
	default n
	depends APPS_LOGIC
	help
		Configuration module


config APPS_LOGIC_SAMBA
	bool 'SAMBA Configuration'
	default n
	depends on APPS_LOGIC
	help
		Configuration module

choice
		prompt "Samba Type"
		default APPS_LOGIC_TW_SAMBA
		depends on APPS_LOGIC_SAMBA
	config APPS_LOGIC_TF_SAMBA
		bool 'TF_SAMBA'
	config APPS_LOGIC_TW_SAMBA
		bool 'TW_SAMBA'
        config APPS_LOGIC_KC_SAMBA
                bool 'KCODES_SAMBA'
endchoice

config APPS_LOGIC_FIREWALLLOG
	bool 'FIREWALLLOG Configuration'
	default n
	depends on APPS_LOGIC
	help
		Firewall Configuration module

#
# QoS start
#
	config APPS_LOGIC_QOS
		bool 'QOS Configuration'
		default n
		depends on APPS_LOGIC
		select OPENSOURCE_IPROUTE2
		select OPENSOURCE_EBTABLES
		select OPENSOURCE_IPTABLES
		help
		Configuration module

	choice
		prompt "QOS Type"
		default APPS_LOGIC_QOS_IMQ
		depends on APPS_LOGIC_QOS

	config APPS_LOGIC_QOS_IFB
		bool 'QOS IFB'	
	
	config APPS_LOGIC_QOS_IMQ
		bool 'QOS IMQ'

  config QOS_WAN_ADSL
    bool 'Enable Macor QOS_WAN_ADSL'
    default y
    depends on APPS_LOGIC_QOS_IMQ			
	
	endchoice  
  
#
# QoS end
#



choice
        prompt "Static Route Type"
        default APPS_LOGIC_STATIC_ROUTING
	depends on APPS_LOGIC
config APPS_LOGIC_STATIC_ROUTING
        bool 'Static Routing + Route Info'
        help
                Static Routing + Route info
config APPS_LOGIC_SROUTE
        bool 'Sroute'
        help
                Sroute module
endchoice


config APPS_LOGIC_FIREWALL
	bool 'Firewall'
	default n
	depends on APPS_LOGIC
	help
		Firewall module

config APPS_LOGIC_TF_GUI
        bool 'gui for telefonica'
        default n
        depends on APPS_LOGIC 
        help
 	       gui for telefonica
config APPS_LOGIC_ANTIATTACK
	bool 'AntiAttack'
	default n
	depends on APPS_LOGIC
	help
		AntiAttack module

config APPS_LOGIC_DROUTE
	bool 'Dynamic Routing'
	default n
	depends on APPS_LOGIC
	select OPENSOURCE_ZEBRA
	help
		Dynamic Routing

config APPS_LOGIC_SNTP
	bool 'SNTP'
	default n
	depends on APPS_LOGIC
	help
		for the configuration of msntp

config APPS_LOGIC_USB_MASS
	bool 'USB Mass Manager'
	default n
	depends on APPS_LOGIC
	help
		An upper App For USB Storage Info, Make sure has enabled the concerned USB driver.

config APPS_LOGIC_IPPMNGR
	bool 'USB Printing Manager'
	default n
	depends on APPS_LOGIC
	help
		USB Printing. Make sure enable the IPPD and USB-Printer support too.

config APPS_LOGIC_FTPD
	bool 'FTPD'
	select OPENSOURCE_FTPD
	default n
	depends on APPS_LOGIC
	help
		FTPD module. Make sure the FTPD Daemon in Opensource has been on tick.

choice
	prompt "password Support"
	default n
	depends on APPS_LOGIC_FTPD

	config APPS_LOGIC_FTPD_TBS
		bool 'TBS FTPD'
		help
			TBS FTPD.

	config APPS_LOGIC_FTPD_CT
		bool 'China-Telecom FTPD'
		help
			Support China-Telecom FTPD requirement.
endchoice

config APPS_LOGIC_PROUTE
	bool 'Policy Route'
	default y
	depends on APPS_LOGIC
	help
		Policy Route, config Policy Route

config APPS_LOGIC_URL_FILTER
	bool 'URL Filter'
	default n
	depends on APPS_LOGIC
	help
		URL Filter Module

config APPS_LOGIC_MACFILTER
	bool 'MAC Filter'
	default n
	depends on APPS_LOGIC
	help
		MAC Filter Module

config APPS_LOGIC_DEVINFO
	bool 'DevInfo'
	default y
	depends on APPS_LOGIC
	help
		devinfo module, manage all misc nodes.

config APPS_LOGIC_WEBPROXY
	bool 'WAN Page Web Proxy'
	default y
	depends on APPS_LOGIC
	help
	WAN Page Web Proxy

config APPS_LOGIC_SUPP
	bool '802.1x supplicant'
	default N
	depends on APPS_LOGIC
	select APPS_SUPP
	help
		802.1x supplicant module.

config APPS_LOGIC_TRACERT
	bool 'traceroute'
	default y
	depends on APPS_LOGIC
	select TRACEROUTE
	select FEATURE_TRACEROUTE_USE_ICMP
	help
		traceroute module.

config APPS_LOGIC_SCHEDULE
	bool 'Schedule'
	default y
	depends on APPS_LOGIC
	help
		schedule module.
		
config APPS_LOGIC_SPT
	bool 'shareprotection'
	default n
	depends on APPS_LOGIC
	help
		share protection module.		

config APPS_LOGIC_TRADITIONALNAT
	bool 'TraditionalNAT'
	default n
	depends on APPS_LOGIC
	help
		Traditional NAT module.	
		
config APPS_LOGIC_TR143
	bool 'TR143'
	default n
	depends on APPS_LOGIC
	help
		tr143 module.	


config APPS_LOGIC_DHCP6S
        bool 'DHCP6S'
        default y
        depends on APPS_LOGIC && TBS_SUPPORT_IPV6
        help
		DHCP6S module

config APPS_LOGIC_RADVD
        bool 'RADVD'
        default y
        depends on APPS_LOGIC && TBS_SUPPORT_IPV6
        help
        	RADVD module
    
config APPS_LOGIC_V6CONN
        bool 'V6CONN'
        default y
        depends on APPS_LOGIC && TBS_SUPPORT_IPV6
        help
 	       V6CONN module

config IPV6_UNNUMBERED_LINS
        bool 'UNNUMBERED_LINKS'
        default y
        depends on APPS_LOGIC_V6CONN
        help
               ipv6 unnumbered links support

config APPS_LOGIC_V6SROUTE
         bool 'IPv6 Static Routing'
         default y
         depends on APPS_LOGIC && TBS_SUPPORT_IPV6
         help
 	        IPv6 Static Routing

config APPS_LOGIC_SUPPORT_PPPV6
        bool 'PPPv6'
        default y
        depends on APPS_LOGIC && TBS_SUPPORT_IPV6
        help
 	       V6CONN module


config APPS_LOGIC_TF_FIREWALL
        bool 'firewall for telefonica'
        default n
        depends on APPS_LOGIC 
        help
 	       firewall for telefonica
 	       
config APPS_LOGIC_TF_PORTMAPPING
        bool 'TF_PORTMAPPING'
        default n
        depends on APPS_LOGIC 
        help
 	       this module response for lan eth-port bind in wizard-web

config APPS_LOGIC_SUPPORT_CPUUSAGE
        bool 'CPUUsage'
        default n
        depends on APPS_LOGIC
        help
 	       CPU module

config APPS_LOGIC_TF_IGMP
	bool 'Tf IGMP Proxy & Snooping'
    default n
    depends on APPS_LOGIC
	select OPENSOURCE_IGMPPROXYV3
    help
    	Tf IGMP Proxy & Snooping Configuration Module

config APPS_LOGIC_DLNA
	bool 'DLNA DMS Support'
	default n
	select OPENSOURCE_DLNA
	depends on APPS_LOGIC
	help
		DLNA DMS Support

config APPS_LOGIC_IPTUNNEL
	bool 'IPTunnel'
	default y
	depends on APPS_LOGIC
	help
	Logic IPTunnel module.

config APPS_LOGIC_IPTUNNEL_RESERVE
	bool 'IPTunnel reserve'
	default y
	depends on APPS_LOGIC_IPTUNNEL
	help
	Logic IPTunnel module.
	

config APPS_LOGIC_UTMPROXY
	bool 'Sitcom Utmproxy'	
	default n
	depends on APPS_LOGIC && (CUSTOMER_SITECOM)
	help 
	SITCOM UTMPROXY Cloud

config APPS_LOGIC_AUTOUPGRADE
	bool 'Sitcom Autoupgrade'
	default n
	depends on APPS_LOGIC && (CUSTOMER_SITECOM)
	help
	SITCOM AUTO UPGRADE

config APPS_LOGIC_REMOTEMANAGE
    bool 'remote manage'
    default n
    depends on APPS_LOGIC
    help
    	Wan remote manage

config APPS_LOGIC_WANMIRROR
        bool 'Wan mirror'
        default n
        depends on APPS_LOGIC
        help
        	Wan mirror support

config APPS_LOGIC_FIREWALL_IPV6
	bool 'Support IPv6 Firewall'
	default y
	depends on APPS_LOGIC && TBS_SUPPORT_IPV6
	help
	IPV6 feature
	
config APPS_LOGIC_MT7510
	bool 'MT7510'
	default n
	depends on APPS_LOGIC
	help
	  MT7510 module

config APPS_LOGIC_MT7511
	bool 'MT7511'
	default n
	depends on APPS_LOGIC
	help
	  MT7511 module

config APPS_LOGIC_DLink_AC750
	bool 'D-Link-AC750'
	default n
	depends on APPS_LOGIC
	help
	  D-Link-AC750 module

config APPS_LOGIC_MDNS
	bool 'dlink mdns'
	default y
	depends on APPS_LOGIC
	help 
	    dlink mdns support

choice
	prompt "TR069 PASSWORD SELECTION"
	default n
	depends on APPS_LOGIC
	
	config APPS_LOGIC_TR069_PASSWORD_Default 
		bool 'Default'
		help
			TR069 Password use MACAddress.

	config APPS_LOGIC_TR069_PASSWORD_Argentina 
		bool 'PASSWORD_Argentine '
		help
			TR069 Password use "password".

	config APPS_LOGIC_TR069_PASSWORD_Columbia 
		bool 'PASSWORD_Columbia'
		help
			TR069 Password use front 6 char of MACAddress.

	config TELEFONICA_CHILE 
		bool 'Telefonica_Chile'
		help
			Pppoe&wlan username and password use the mac and serialnumber
endchoice
```
