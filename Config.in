## src/apps/ssap/Config.in
```kconfig
menuconfig APPS_SSAP
	bool 'SSAP'
	default y
	depends on APPS
  	help
      	SSAP


config APPS_SSAP_BUTTON
	bool 'Button'
	default n
	depends on APPS_SSAP
	help
		Button module	
	
config APPS_SSAP_PROTEST
	bool 'Product test'
	default n
	depends on APPS_SSAP
	help
		Product test module	

config APPS_SSAP_UPGRADE
	bool 'Upgrade'
	default y
	depends on APPS_SSAP
	help
		Upgrade module	

config APPS_SSAP_TFTPUPG
    bool 'tftp_upg'
    default y
    depends on APPS_SSAP_UPGRADE
    help
       For tftp upgrade 

config APPS_SSAP_GETSMAPS
    bool 'getsmaps'
	depends on APPS_SSAP
    default n
    help
        For test only,the progress can count a process's memory 

config APPS_SSAP_RCDMODULETM
    bool 'record module time'
	depends on APPS_SSAP
    default n
    help
        For test only,the progress can count time of logic's module calling function 

config APPS_SSAP_APPLY_EACH_FUNC_HOOK
    bool 'enable APPLY_EACH_FUNC hook'
	depends on APPS_SSAP
    default n
    help
        Enable APPLY_EACH_FUNC hook
```

## src/apps/web/Config.in
```kconfig
###################################################
choice
	prompt "HTTP Auth"
	default APPS_WEB_COMMON
	depends on APPS_WEB

	config APPS_WEB_COMMON
		boolean "Common"
		select APPS_LOGIC_LOGOUT
		help
			We use tbs authentication as default auth.

	config APPS_LOGIC_LOGOUT
    	bool "Logout page"
    	depends on APPS_WEB_COMMON
    	help
        	if use tbs authentication , will show a logout page.


	config APPS_WEB_BASIC
		boolean "Basic"
		help
			HTTP Basic authentication as default auth.

endchoice
####################################################
```

## src/driver/tbs/Config.in
```kconfig
menuconfig DRIVERS_TBSMOD
        bool 'Tbsmod'
        default y
        depends on DRIVERS
        help
					tbs module



source driver/tbs/button/Config.in
source driver/tbs/led/Config.in
source driver/tbs/nfp_adapter/Config.in
source driver/tbs/tbs_nfp/Config.in
```

## src/driver/tbs/button/Config.in
```kconfig
menuconfig TBSMOD_BUTTON	
	bool 'button'
        default y
        depends on DRIVERS_TBSMOD
        help
		button module

choice
	prompt "button module"
	depends on TBSMOD_BUTTON

config BUTTON_AMAZON_SE
    	boolean "amazon_se"
	depends on AMAZON_SE

config	BUTTON_RT3052 
	boolean "RT3052"
	depends on RT3052

config	BUTTON_VX180 
	boolean "VX180"
	depends on VX180

config	BUTTON_RTL8672 
	boolean "RTL8672"
	depends on RTL8672
	
config	BUTTON_RTL8196C
	boolean "RTL8196C"
	depends on RTL8196C

config	BUTTON_C1000
	boolean "C1000"
	depends on C1000

config	BUTTON_C1000_INT
	boolean "C1000_INT"
	depends on C1000_INT

config	BUTTON_BCM5358
	boolean "BCM5358"
	depends on BCM5358

config	BUTTON_MV88F6560P
	boolean "MV88f6560P"
	depends on MV88f6560P

config  BUTTON_RT65168
	boolean "RT65168_VDSL"
	depends on RT65168

config  BUTTON_RT63365
	boolean "RT63365_ADSL"
	depends on RT63365

config  BUTTON_RT63368
	boolean "RT63368"
	depends on RT63368

config  BUTTON_MT7620
	boolean "MT7620"
	depends on MT7620

config  BUTTON_MT751X
	boolean "MT751X"
	depends on MT751X
endchoice

config BUTTON_TRIGGER_TIMER
	bool "Button trigger timer"
	depends on TBSMOD_BUTTON
	help
	  This option enable button timer trigger function.
	  If button device use interrupt,say N.
	  If no interrupt, say Y.
```

## src/driver/tbs/led/Config.in
```kconfig
menuconfig TBSMOD_LED
	bool "TBS LED core framework support"
	default y
	depends on DRIVERS_TBSMOD
	help
	  TBS leds core for gpio leds.

if TBSMOD_LED

config NEW_LED
	bool "LED Support"
    	default y
    	depends on TBSMOD_LED
    	help
      		This option enables support leds for the Realtek rtl8672

comment "LED drivers"

config LED_RTL8672
	bool "LED support for the RTL8672"
    	default y
    	depends on TBSMOD_LED && RTL8672
    	help
      		This option enables support leds for the Realtek rtl8672

config LED_RTL8676
    	bool "LED support for the RTL8676"
	default y
	depends on TBSMOD_LED && RTL8676
    	help
      		This option enables support leds for the Realtek rtl8676

config LED_RT65168
    	bool "LED support for the RT65168"
    	default y
	depends on TBSMOD_LED && RT65168
    	help
      		This option enables support leds for the Ralink rt65168 vdsl

config LED_RT63365
    	bool "LED support for the RT63365"
    	default y
	depends on TBSMOD_LED && RT63365
    	help
      		This option enables support leds for the Ralink rt65168 vdsl

config LED_RT63368
    	bool "LED support for the RT63368"
    	default y
	depends on TBSMOD_LED && RT63368
    	help
      		This option enables support leds for the MTK rt63368

config LED_MT7620
    	bool "LED support for the MT7620"
    	default y
	depends on TBSMOD_LED && MT7620
    	help
      		This option enables support leds for the MTK mt7620

config LED_MT751X
    	bool "LED support for the MT751X"
    	default y
	depends on TBSMOD_LED && MT751X
    	help
      		This option enables support leds for the MTK mt751x

endif
```

## src/driver/tbs/nfp_adapter/Config.in
```kconfig
#menuconfig TBS_NFP_ADAPTER
#        bool "TBS NFP Adapter"
#        default y
#	depends on DRIVER
#	select IP_ROUTE_CACHE_NOTIFY
#        ---help---
#          Select this and you will be able to support Network Fast Processing Adapter

menuconfig TBS_NFP_ADAPTER
        
        bool "TBS NFP Adapter"
        default n
        depends on DRIVERS_TBSMOD
        select IP_ROUTE_CACHE_NOTIFY
        ---help---
          Select nfp type for this adapter

	choice
                prompt "NFP Type"
                default TBS_NFP_TBS_ADAPTER
                depends on TBS_NFP_ADAPTER

                config TBS_NFP_TBS_ADAPTER
                        bool 'TBS NFP'
                        help
                                use marvell NFP

                config TBS_NFP_MARVELL_ADAPTER
                        bool 'Marvell NFP'
                        help
                                use marvell NFP

                config TBS_NFP_MINDSPEED_ADAPTER
                        bool 'Mindspeed FPP'
                        help
                                use mindspeed FPP
        
	endchoice

config NFP_ADAPTER_DEBUG
        bool "NFP Adapter Debug"
        default n
        depends on TBS_NFP_ADAPTER
        ---help---
          Select this and you open debug for nfp_adapter and marvell_nfp_adapter modules
```

## src/driver/tbs/tbs_nfp/Config.in
```kconfig
######################################
#
#
######################################
menuconfig TBS_NFP
        bool "Use Tbs Network Fast Processing (TBS NFP)"
	depends on DRIVERS_TBSMOD && TBS_NFP_ADAPTER
        default y
        ---help---
        Choosing this option will include TBS NFP support in the image.

config TBS_NFP_DEF
        depends on TBS_NFP
        int "Default value for TBS NFP:  0 - disable, 1 - enable"
        default 0
        ---help---


menuconfig TBS_NFP_BRIDGE
	bool "Support TBS NFP Bridging"
	depends on TBS_NFP && BRIDGE
	default y
	---help---
	Choosing this option will enable NFP Bridging
choice
	prompt "Support TBS NFP Bridging by fdb or bridge rule"
        default TBS_NFP_BRIDGE_RULE
        depends on TBS_NFP_BRIDGE

	config TBS_NFP_FDB
        	bool "Support TBS NFP Bridging by fdb"
        	depends on TBS_NFP_BRIDGE
        	---help---
        	Choosing this option will enable NFP Bridging by fdb.

	config TBS_NFP_BRIDGE_RULE
        	bool "Support TBS NFP Bridging by Bridge Rule"
        	depends on TBS_NFP_BRIDGE
        	---help---
        	Choosing this option will enable TBS NFP Bridging by Bridge Rule.
endchoice


config TBS_NFP_VLAN
        bool "Support TBS NFP VLANs processing"
        default y
        depends on TBS_NFP
        ---help---
        Choosing this option will enable TBS NFP VLANs support.


config TBS_NFP_FIB
        bool "Support TBS NFP routing"
        default y
        depends on TBS_NFP
        ---help---
        Choosing this option will enable TBS NFP routing support.

config TBS_NFP_CT
        bool "Support TBS NFP 5 Tuple Rules"
        depends on TBS_NFP_FIB && NF_CONNTRACK && (NF_CONNTRACK_ENABLED || NF_CONNTRACK_IPV4)
		select TBS_NFP_NAT
        default y
        ---help---
        Choosing this option will enable TBS NFP 5 Tuple Rules support.

config TBS_NFP_NAT
        bool "Support TBS NFP NAT"
        depends on TBS_NFP_FIB && TBS_NFP_CT
        ---help---
        Choosing this option will enable TBS NFP NAT support.

config TBS_NFP_PPP
        bool "Support TBS NFP PPPoE"
        depends on TBS_NFP && PPPOE
        default y
         ---help---
        Choosing this option will enable TBS NFP PPPoE protocol.

config TBS_NFP_WLAN
        bool "Support TBS NFP WLAN"
        depends on TBS_NFP
        default n
         ---help---
        Choosing this option will enable TBS NFP WLAN.

config  TBS_NFP_STATS
        bool "Collect TBS NFP statistics"
        depends on TBS_NFP
        default n
        ---help---
        Collect TBS NFP statistics. Can be displayed using sysfs command.

config TBS_NFP_DEBUG
        bool "TBS NFP Debug"
        default n
        depends on TBS_NFP
        ---help---
          Choosing this option will enable debug for tbs_nfp module.
```

## src/driver/wireless/Config.in
```kconfig
menuconfig DRIVERS_WLAN
	bool 'Wireless drivers'
	default n
	depends on DRIVERS
	help
		Wireless device driver module

source driver/wireless/atheros/Config.in
source driver/wireless/ralink/Config.in
source driver/wireless/realtek/Config.in
```

## src/kernel/linux-2.6.30/drivers/button/Kconfig
```kconfig
menu "Button drivers"

config TBS_BUTTON
	bool "TBS Button Support"
	help
	  Say Y to enable TBS Button driver framwork.This allows monitor of supported
	  buttons.


comment "Button device"


config BUTTON_AR7130
	tristate "Button support for the AR7130"
	depends on TBS_BUTTON && MACH_AR7100
	help
	  This option enables support for the buttons on AR7130.


config BUTTON_AMAZON_SE
	tristate "Button support for the Amazon-SE"
	depends on TBS_BUTTON && AMAZON_SE
	help
	  This option enables support for the buttons on Infineon Amazon-SE.

config BUTTON_RT3052
	tristate "Button support for the RT3052"
	depends on TBS_BUTTON && RALINK_RT3052
	help
	  This option enables support for the buttons on Ralink rt3052.

config BUTTON_VX180
	tristate "Button support for the VX180"
	depends on TBS_BUTTON && FUSIV_VX180
	help
	  This option enables support for the buttons on IKANOS Vx180.

config BUTTON_RTL8672
	tristate "Button support for the RTL8672"
	depends on TBS_BUTTON && RTL8672
	help
	  This option enables support for the buttons on Realtek RTL8672.

config BUTTON_RTL8196C
	tristate "Button support for the RTL8196C"
	depends on TBS_BUTTON && RTL_8196C
	help
	  This option enables support for the buttons on Realtek RTL8196C.
	  
config BUTTON_RTL8196D
	tristate "Button support for the RTL8196D"
	depends on TBS_BUTTON && RTL_8196D
	help
	  This option enables support for the buttons on Realtek RTL8196D.	
	  
config BUTTON_RTL8196E
	tristate "Button support for the RTL8196E"
	depends on TBS_BUTTON && RTL_8196E
	help
	  This option enables support for the buttons on Realtek RTL8196E.
	  
config BUTTON_RTL8197D
	tristate "Button support for the RTL8197D"
	depends on TBS_BUTTON && RTL_8197D
	help
	  This option enables support for the buttons on Realtek RTL8197D.
      
config BUTTON_RTL8197DL
    tristate "Button support for the RTL8197DL"
    depends on TBS_BUTTON && RTL_8197DL
    help
      This option enables support for the buttons on Realtek RTL8197DL.

config BUTTON_C1000
	tristate "Button support for the C1000(poll mode)"
	depends on TBS_BUTTON && ARCH_M83XXX
	help
	  This option enables support for the buttons on Mindspeed C1000.

config BUTTON_C1000_INT
	tristate "Button support for the C1000(interrupt mode)"
	depends on TBS_BUTTON && ARCH_M83XXX
	help
	  This option enables support for the buttons on Mindspeed C1000.

comment "Button option"

config BUTTON_TRIGGER_TIMER
	tristate "Button trigger timer"
	depends on TBS_BUTTON
	help
	  This option enable button timer trigger function.
	  If button device use interrupt,say N.
	  If no interrupt, say Y.

endmenu
```
