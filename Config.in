## Config.in
```kconfig
#############################################################################
#
# NOTE : it is fairly important that changes to this file consider their
#        effect on other platforms and default setups.  If you can, only
#        add to the file,  changing the name of a variable will break
#        many configurations.
#
#
#############################################################################

mainmenu "T&W Broadband System Configuration"

#############################################################################

comment 'TBS Board Configuration'
choice
	prompt "Chipset Type"
config MT751X
        bool "MT7510/MT7511(MTK)"
config MTK7620A
        bool "MTK7620A(MTK)"

config RTL8197DN	
	select RTL8197D
	bool "RTL8197DN(RTL)"
	
config RTL8197DL
	select RTL8197D
	bool "RTL8197DL(RTL)"
endchoice

#no comments of RTL8197D but configed by RTL8197DN/RTL8197DL
config RTL8197D	
	bool

source BoardConfig.in      
comment 'TBS Source Code Configuration'

source apps/Config.debug.in

config TBS_SUPPORT_SWITCH_VLAN
    bool "TBS Support Switch Vlan"
    default y
    help
      Setting TBS Support Switch Vlan

config TBS_SUPPORT_IPV6
	bool "TBS Support IPV6"
	default n
	select APPS_LOGIC_SUPPORT_IPV6
	help
	  Setting TBS whether or not to support ipv6

config TBS_MASSIVE_UPGRADE
        bool "TBS Massive upgrade tool support"
	default n
	help
	  Setting TBS whether or not to support Massive upgrade. Enable this will cost more 6 seconds when boot.
	  
#source hal/Config.in      
#source boot/Config.in
source apps/Config.in
source opensource/Config.in
source vendor/Config.in
source driver/Config.in
     

comment 'Linux Kernel Configuration'
source kernel/Config.in
```

## GplMakeCode/gpl_config/driver/Config.in
```kconfig
menuconfig DRIVERS
	bool 'Drivers'
	default y
	help 
	Driver

#source src/driver/wireless/Config.in
```

## GplMakeCode/gpl_config/driver/wireless/Config.in
```kconfig
menuconfig DRIVERS_WLAN
	bool 'Wireless drivers'
	default n
	depends DRIVERS
	help
		Wireless device driver module

#source src/driver/wireless/realtek/Config.in
```

## GplMakeCode/gpl_config/vendor/Config.in
```kconfig
######################################
#
#
######################################
menuconfig VENDOR
  bool "Vendor Applications"
  default y

#source src/vendor/atheros/Config.in

#
#TBS-TAG:by ouyangdi 2008-11-29
#DESC:添加infineon dsl API
#
#source src/vendor/infineon/Config.in
#TBS-TAG:add ralink/802.1x 2009-1-4
source src/vendor/ralink/Config.in

#source src/vendor/ikanos/Config.in

#source src/vendor/mindspeed/Config.in
source src/vendor/realtek/Config.in
```

## src/apps/Config.in
```kconfig
######################################
#
#
######################################
menuconfig APPS
  bool "Applications"
  default y

source apps/ssap/Config.in  
source apps/logic/Config.in  

source apps/ipv6/Config.in
source apps/cmddaemon/Config.in
config APPS_CLI
	bool 'CLI'
	default y
	depends on APPS
  	help 
      	CLI(Command Line Interface)
      
menu "TR069FE"
	depends on APPS
	config APPS_TR069
		bool 'TR069'
		default n
		depends on APPS_LOGIC_TR069 && APPS
		help
		TR069FE
source apps/tr069fe/Config.in
endmenu

menu "TR064FE"
    depends on APPS
    config APPS_TR064
		bool 'TR064'
		default n
		depends on APPS_LOGIC_TR064BE && APPS
		help
		TR064FE
source apps/tr064fe/Config.in
endmenu
      
config APPS_WEB
	bool 'WEB'
	default y
	depends on APPS
	select OPENSOURCE_HTTPD
  	help
      	WEB       
source apps/web/Config.in
source apps/html/Config.in

config APPS_TM
        bool 'TM'
        default n
        depends on APPS
        help
        TM
config APPS_UPGCGI
	boolean "upgcgi"
	default n
	depends on APPS
	help
	CGI upg
source apps/supp/Config.in

source apps/captival-portal/Config.in
```

## src/apps/cmddaemon/Config.in
```kconfig
config APPS_CMDDAEMON
	bool 'CMMDAEMON'
	default n
	depends on APPS
	help
		used for applying cmds at bg
```

## src/apps/html/Config.in
```kconfig
######################################

config APPS_HTML
	bool 'HTML'
	default y
	depends on APPS
	select APPS_WEB
	#select APPS_HTML_PAGE_system_msg
  	help
      	  HTML Pages
######################################
menu "Languages"
	depends on APPS_HTML

	menu "All Supported Languages"
		depends on APPS_HTML

		config APPS_HTML_LANG_SUPPORT_en_us
			bool 'English'
			default y
			help
				Support English Language.

		config APPS_HTML_LANG_SUPPORT_zh_cn
			bool 'Chinse'
			default y
			help
				Support Chinse Language.

	endmenu

	choice
		prompt "Default language"
		default APPS_HTML_LANG_DEFAULT_zh_cn
		depends on APPS_HTML

		config APPS_HTML_LANG_DEFAULT_en_us
			bool 'English'
			select APPS_HTML_LANG_SUPPORT_en_us
			help
				English as default language.

		config APPS_HTML_LANG_DEFAULT_zh_cn
			bool 'Chinese'
			select APPS_HTML_LANG_SUPPORT_zh_cn
			help
				Chinese as default language
	endchoice



endmenu
######################################
menu "Web Style"
	depends on APPS_HTML
	choice
		prompt "All Supported Style"
		default APPS_HTML_WEB_STYLE_Blue
		depends on APPS_HTML

		config APPS_HTML_WEB_STYLE_DLINK_AC750
			bool 'dlink_AC750'
			help
				Web DLINK AC750 style			
						
		config APPS_HTML_WEB_STYLE_DLINK_AC750_DIR815D1
			bool 'dlink_AC750D_DIR815D1'
			help
				Web DLINK AC750 DIR815D1 style	

		config APPS_HTML_WEB_STYLE_SITECOM
			bool 'Sitecom'
			help
				Web  Sitecom  style

		config APPS_HTML_WEB_STYLE_ACT
			bool 'ACT'
			help
				Web  ACT  style
	endchoice
	
	choice
		prompt "Default Style"
		default APPS_HTML_WEB_STYLE_DEFAULT_Blue
		depends on APPS_HTML

		config APPS_HTML_WEB_STYLE_DEFAULT_DLINK_AC750
			bool 'dlink_AC750'
			select APPS_HTML_WEB_STYLE_DLINK_AC750
			help
				Dlink AC750 as default style

		config APPS_HTML_WEB_STYLE_DEFAULT_SITECOM
			bool 'Sitecom'
			help
				Web  Sitecom  style
		
		config APPS_HTML_WEB_STYLE_DEFAULT_ACT
			bool 'ACT'
			help
				Web  ACT  style
	endchoice
	
	config APPS_HTML_WEB_LOGIN_WIZARD
			bool 'telefonica login wizard'
			default n
			help
				 telefonica's request when logging in the CPE ,  pop out a specific wizard page
				 
	
endmenu
```
